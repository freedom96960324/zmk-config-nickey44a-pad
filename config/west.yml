## config/west.yml
```yaml
manifest:
  remotes:
    - name: zmkfirmware
      url-base: https://github.com/zmkfirmware
    - name: cormoran
      url-base: https://github.com/cormoran
    - name: caksoylar  # <-- RGB LED
      url-base: https://github.com/caksoylar
    - name: yuchamichami
      url-base: https://github.com/yuchamichami
    - name: kot149
      url-base: https://github.com/kot149
  projects:
    - name: zmk
      remote: cormoran
      revision: 3931facea7507151a53f209ca4f8a717fa6bd400 # v0.3-branch+dya
      import: app/west.yml
    - name: zmk-rgbled-widget
      remote: caksoylar
      revision: 8756cb7b8114069fa3c25c6f6c990f24988fceff # v0.3
    - name: zmk-driver-yupad43
      remote: yuchamichami
      revision: 5dfa6d3c480ebb5162f5425fa367823d73ddb13e
    - name: zmk-scroll-snap
      remote: kot149
      revision: 6b2dccaab2d5b99ca8b79300b9a792fefb01c42d # v1
  self:
    path: config
```
